/*@!Encoding:1252*/
includes
{
  #include "GT.cin"
  #include "Common.cin"
}

variables
{ 
  mstimer demoTimer, startTimer;
  int64 currentLocalTime;
  const long cDemoTimerCycle = 1000;
  
  //SKMP protocol constants
  const int instanceKey = 902;
  
  byte masterKey[MASTER_KEY_LEN] = {0x2, 0x2, 0x2, 0x2, 0x2,
                                   0x2, 0x2, 0x2, 0x2, 0x2, 
                                   0x2, 0x2, 0x2, 0x2, 0x2,
                                   0x2, 0x2, 0x2, 0x2, 0x2, 
                                   0x2, 0x2, 0x2, 0x2, 0x2,
                                   0x2, 0x2, 0x2, 0x2, 0x2, 
                                   0x2, 0x2};
  
  byte seed[SEED_LEN] = {0x3, 0x3, 0x3, 0x3,
                        0x3, 0x3, 0x3, 0x3, 
                        0x3, 0x3, 0x3, 0x3, 
                        0x3, 0x3, 0x3, 0x3};
  mstimer keyTimer;
}

on preStart 
{
  int retVal = 0;
  
  retVal = dll_InitInstance(instanceKey,
                            masterKey,
                            MASTER_KEY_LEN,
                            seed,
                            SEED_LEN,
                            CID_2,
                            GID_2);
  
  if (retVal == 0)
  {
    write("Master instance: %d init successfull", instanceKey);  
  }
  else
  {
    write("preStart error. Return %d", retVal);
  }
  retVal = dll_SetupInstance(instanceKey);
  
  if (retVal == 0)
  {
    write("Master instance: %d setup successfull", instanceKey);  
  }
  else
  {
    // TODO: Should stop simulation?
    write("preStart error. Return: %d Instance: %d", retVal, instanceKey);
  }
}

on start
{
  keyTimer.set(1000);
  startTimer.set(300);
}

on timer startTimer
{
  //Start the demo timer
  demoTimer.set(cDemoTimerCycle);
  currentLocalTime = timeNowInt64();
}

on timer demoTimer
{
  int64 calcTime;
  
  calcTime = GT_SLAVE_TIME_TO_MASTER_TIME_NS(currentLocalTime + cDemoTimerCycle * 1e6); 
  writeLineEx(-3, 0, "GT SLAVE \"%NODE_NAME%\" TIMER EVENT: Local slave time is %fs, calculated Master time is %fs, difference: %fs.",timenowint64()/1e9, calcTime / 1e9, (timenowint64() - calcTime) / 1e9);
  
  this.set(cDemoTimerCycle);
  currentLocalTime = timeNowInt64();
}

on timer keyTimer
{
  int retVal;
  int index;
  byte macTrunc[MAC_TRUNC_LEN];
  byte timestamp = 0;
  message MasterMACG2 msg;
  
  retVal = dll_GenerateKey(instanceKey,
                           macTrunc,
                           MAC_TRUNC_LEN,
                           timestamp);

  if (retVal == 0)
  {
    write("Master instance: %d new key, CID: %d GID: %d", 
          instanceKey, CID_2, GID_2);  
  }
  else
  {
    // TODO: Should stop simulation?
    write("Master key error. Return: %d Instance: %d", retVal, instanceKey);
  }
  
  for (index=0; index<MAC_TRUNC_LEN; index++)
  {
    msg.byte(index) = macTrunc[index];
  }
  msg.dlc = 8;
  
  output(msg);
  this.set(1000);
}
