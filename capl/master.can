/*@!Encoding:1252*/
includes
{
  #include "GT.cin"
  #include "Common.cin"
}

variables
{
  //Global Time constants
  const byte GT_MASTER = 1;
  const byte GT_DOMAIN = 1;
  const byte GT_SGW = 0;
  const byte GT_CRC = 1;
  const long GT_CAN_ID = 0x123;
  const byte GT_VERBOSE = 1;
  
  //SKMP protocol constants
  const int instanceKey = 101;
  
  byte masterKey[MASTER_KEY_LEN] = {0x1, 0x1, 0x1, 0x1, 0x1,
                                   0x1, 0x1, 0x1, 0x1, 0x1, 
                                   0x1, 0x1, 0x1, 0x1, 0x1,
                                   0x1, 0x1, 0x1, 0x1, 0x1, 
                                   0x1, 0x1, 0x1, 0x1, 0x1,
                                   0x1, 0x1, 0x1, 0x1, 0x1, 
                                   0x1, 0x1};
  
  byte seed[SEED_LEN] = {0x2, 0x2, 0x2, 0x2,
                        0x2, 0x2, 0x2, 0x2, 
                        0x2, 0x2, 0x2, 0x2, 
                        0x2, 0x2, 0x2, 0x2};
  timer keyTimer;
}

on preStart 
{
  int retVal = 0;
  
  retVal = dll_InitInstance(instanceKey,
                            masterKey,
                            MASTER_KEY_LEN,
                            seed,
                            SEED_LEN,
                            CID_1,
                            GID_1);
  
  if (retVal == 0)
  {
    write("Master instance: %d init successfull", instanceKey);  
  }
  else
  {
    write("preStart error. Return %d", retVal);
  }
  retVal = dll_SetupInstance(instanceKey);
  
  if (retVal == 0)
  {
    write("Master instance: %d setup successfull", instanceKey);  
  }
  else
  {
    // TODO: Should stop simulation?
    write("preStart error. Return: %d Instance: %d", retVal, instanceKey);
  }
}

on start
{
  //setTimer(keyTimer, 1);  
  GT_MASTER_START();
}

on timer keyTimer
{
  int retVal;
  int index;
  byte macTrunc[MAC_TRUNC_LEN];
  byte timestamp = 0;
  message 0x50 msg;
  
  retVal = dll_GenerateKey(instanceKey,
                           macTrunc,
                           MAC_TRUNC_LEN,
                           timestamp);

  if (retVal == 0)
  {
    write("Master instance: %d new key, CID: %d GID: %d", 
          instanceKey, CID_1, GID_1);  
  }
  else
  {
    // TODO: Should stop simulation?
    write("Master key error. Return: %d Instance: %d", retVal, instanceKey);
  }
  
  for (index=0; index<MAC_TRUNC_LEN; index++)
  {
    msg.byte(index) = macTrunc[index];
  }
  msg.dlc = 8;
  
  output(msg);
}